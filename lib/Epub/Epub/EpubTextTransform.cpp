#include "EpubTextTransform.h"

#include <Utf8.h>

#include <cstdint>
#include <cstring>
#include <string>

namespace {
struct PhraseMapping {
  const char* simplified;
  const char* traditional;
};

struct CharMapping {
  uint32_t simplified;
  const char* traditional;
};

constexpr PhraseMapping kPhraseMappings[] = {
    {"后台", "後台"},     {"老板", "老闆"},     {"面包", "麵包"},     {"面条", "麵條"},
    {"里面", "裡面"},     {"公里", "公里"},     {"几乎", "幾乎"},     {"几种", "幾種"},
    {"干净", "乾淨"},     {"干杯", "乾杯"},     {"干燥", "乾燥"},     {"干脆", "乾脆"},
    {"干预", "干預"},     {"开发", "開發"},     {"软件", "軟體"},     {"硬件", "硬體"},
    {"数据", "資料"},     {"质量", "品質"},     {"网络", "網路"},     {"视频", "影片"},
    {"屏幕", "螢幕"},     {"文件", "檔案"},     {"默认", "預設"},     {"启动", "啟動"},
    {"关闭", "關閉"},     {"设置", "設定"},     {"搜索", "搜尋"},     {"书签", "書籤"},
    {"阅读", "閱讀"},     {"词典", "詞典"},     {"注释", "註釋"},     {"注解", "註解"},
    {"页码", "頁碼"},     {"图片", "圖片"},     {"显示", "顯示"},     {"进度", "進度"},
    {"支持", "支援"},     {"自定义", "自訂"},   {"电子书", "電子書"}, {"繁体中文", "繁體中文"},
    {"简体中文", "簡體中文"}, {"用户", "使用者"}, {"当前", "目前"},     {"当前页", "目前頁"},
    {"本章", "本章"},     {"全文", "全文"},     {"跳转", "跳轉"},     {"链接", "連結"},
};

constexpr CharMapping kCharMappings[] = {
    {0x4E07, "萬"}, {0x4E0E, "與"}, {0x4E13, "專"}, {0x4E1A, "業"}, {0x4E1C, "東"}, {0x4E24, "兩"},
    {0x4E25, "嚴"}, {0x4E2A, "個"}, {0x4E30, "豐"}, {0x4E34, "臨"}, {0x4E3A, "為"}, {0x4E3D, "麗"},
    {0x4E3E, "舉"}, {0x4E49, "義"}, {0x4E4C, "烏"}, {0x4E50, "樂"}, {0x4E60, "習"}, {0x4E61, "鄉"},
    {0x4E66, "書"}, {0x4E70, "買"}, {0x4E71, "亂"}, {0x4E89, "爭"}, {0x4E8E, "於"}, {0x4E8F, "虧"},
    {0x4E91, "雲"}, {0x4E9A, "亞"}, {0x4EA7, "產"}, {0x4EB2, "親"}, {0x4EBF, "億"}, {0x4EC5, "僅"},
    {0x4ECE, "從"}, {0x4ED3, "倉"}, {0x4EEA, "儀"}, {0x4EEC, "們"}, {0x4EF7, "價"}, {0x4F17, "眾"},
    {0x4F18, "優"}, {0x4F1A, "會"}, {0x4F1F, "偉"}, {0x4F20, "傳"}, {0x4F24, "傷"}, {0x4F26, "倫"},
    {0x4F2A, "偽"}, {0x4F53, "體"}, {0x4F59, "餘"}, {0x4F5B, "佛"}, {0x4F5C, "作"}, {0x4F60, "你"},
    {0x4F63, "傭"}, {0x4F69, "佩"}, {0x4F73, "佳"}, {0x4FA7, "側"}, {0x4FA8, "僑"}, {0x4FA9, "儈"},
    {0x4FAE, "侮"}, {0x4FAF, "侯"}, {0x4FB5, "侵"}, {0x4FBF, "便"}, {0x4FC3, "促"}, {0x4FE1, "信"},
    {0x4FE9, "倆"}, {0x4FED, "儉"}, {0x4FEE, "修"}, {0x4FEF, "俯"}, {0x500B, "個"}, {0x5011, "們"},
    {0x502B, "倫"}, {0x503A, "債"}, {0x503E, "傾"}, {0x507F, "償"}, {0x50A8, "儲"}, {0x513F, "兒"},
    {0x514B, "克"}, {0x5151, "兌"}, {0x515A, "黨"}, {0x5170, "蘭"}, {0x5173, "關"}, {0x5174, "興"},
    {0x517B, "養"}, {0x517D, "獸"}, {0x5185, "內"}, {0x518C, "冊"}, {0x5199, "寫"}, {0x519B, "軍"},
    {0x519C, "農"}, {0x51B2, "沖"}, {0x51B3, "決"}, {0x51B5, "況"}, {0x51B7, "冷"}, {0x51BB, "凍"},
    {0x51C0, "淨"}, {0x51CF, "減"}, {0x51E0, "幾"}, {0x51FB, "擊"}, {0x51FF, "鑿"}, {0x5206, "分"},
    {0x5218, "劉"}, {0x5219, "則"}, {0x521A, "剛"}, {0x521B, "創"}, {0x5220, "刪"}, {0x522B, "別"},
    {0x522D, "剗"}, {0x5236, "制"}, {0x5237, "刷"}, {0x5238, "券"}, {0x5239, "剎"}, {0x523A, "刺"},
    {0x523B, "刻"}, {0x5242, "劑"}, {0x524D, "前"}, {0x5267, "劇"}, {0x5269, "剩"}, {0x5275, "創"},
    {0x529D, "勸"}, {0x529E, "辦"}, {0x52A1, "務"}, {0x52A8, "動"}, {0x52B1, "勵"}, {0x52B2, "勁"},
    {0x52BF, "勢"}, {0x52CB, "勛"}, {0x5300, "勻"}, {0x5305, "包"}, {0x5316, "化"}, {0x5317, "北"},
    {0x533A, "區"}, {0x534E, "華"}, {0x5355, "單"}, {0x5356, "賣"}, {0x5361, "卡"}, {0x5362, "盧"},
    {0x536B, "衛"}, {0x5385, "廳"}, {0x5386, "歷"}, {0x538B, "壓"}, {0x538C, "厭"}, {0x5395, "廁"},
    {0x53BF, "縣"}, {0x53C2, "參"}, {0x53CC, "雙"}, {0x53D1, "發"}, {0x53D8, "變"}, {0x53E0, "疊"},
    {0x53F0, "臺"}, {0x53F6, "葉"}, {0x53F7, "號"}, {0x5408, "合"}, {0x540E, "後"}, {0x5411, "向"},
    {0x542C, "聽"}, {0x542F, "啟"}, {0x5458, "員"}, {0x5468, "週"}, {0x547C, "呼"}, {0x548C, "和"},
    {0x54CD, "響"}, {0x54D1, "啞"}, {0x54D7, "嘩"}, {0x54E5, "哥"}, {0x54E6, "哦"}, {0x5510, "唐"},
    {0x5524, "喚"}, {0x5546, "商"}, {0x5584, "善"}, {0x5586, "喆"}, {0x55AE, "單"}, {0x55B7, "噴"},
    {0x56B4, "嚴"}, {0x56CA, "囊"}, {0x56E2, "團"}, {0x56ED, "園"}, {0x56F0, "困"}, {0x56F4, "圍"},
    {0x56FD, "國"}, {0x56FE, "圖"}, {0x5706, "圓"}, {0x5723, "聖"}, {0x573A, "場"}, {0x574F, "壞"},
    {0x5757, "塊"}, {0x575A, "堅"}, {0x575B, "壇"}, {0x575F, "墳"}, {0x5782, "垂"}, {0x5783, "垃"},
    {0x57D8, "埘"}, {0x57EF, "垵"}, {0x57FA, "基"}, {0x5806, "堆"}, {0x5899, "牆"}, {0x58F0, "聲"},
    {0x58F3, "殼"}, {0x5904, "處"}, {0x5907, "備"}, {0x590D, "復"}, {0x591F, "夠"}, {0x5934, "頭"},
    {0x593A, "奪"}, {0x594B, "奮"}, {0x5956, "獎"}, {0x5965, "奧"}, {0x5986, "妝"}, {0x5987, "婦"},
    {0x5988, "媽"}, {0x59CB, "始"}, {0x59D4, "委"}, {0x59EA, "姪"}, {0x5A04, "娉"}, {0x5A05, "娛"},
    {0x5A07, "嬌"}, {0x5A31, "娛"}, {0x5A74, "嬰"}, {0x5B57, "字"}, {0x5B66, "學"}, {0x5B9D, "寶"},
    {0x5B9E, "實"}, {0x5BA0, "寵"}, {0x5BA1, "審"}, {0x5BAA, "憲"}, {0x5BAB, "宮"}, {0x5BBD, "寬"},
    {0x5BBE, "賓"}, {0x5BC6, "密"}, {0x5BF9, "對"}, {0x5BFB, "尋"}, {0x5BFC, "導"}, {0x5BFF, "壽"},
    {0x5C06, "將"}, {0x5C14, "爾"}, {0x5C18, "塵"}, {0x5C1D, "嘗"}, {0x5C27, "堯"}, {0x5C42, "層"},
    {0x5C46, "屆"}, {0x5C5E, "屬"}, {0x5C81, "歲"}, {0x5C82, "豈"}, {0x5C97, "崗"}, {0x5C9B, "島"},
    {0x5CAD, "嶺"}, {0x5CB3, "嶽"}, {0x5D07, "崇"}, {0x5DDE, "州"}, {0x5DE5, "工"}, {0x5DE6, "左"},
    {0x5DE8, "巨"}, {0x5DF2, "已"}, {0x5E01, "幣"}, {0x5E05, "帥"}, {0x5E08, "師"}, {0x5E0C, "希"},
    {0x5E10, "帳"}, {0x5E26, "帶"}, {0x5E2E, "幫"}, {0x5E38, "常"}, {0x5E3C, "幘"}, {0x5E72, "干"},
    {0x5E73, "平"}, {0x5E74, "年"}, {0x5E76, "並"}, {0x5E7F, "廣"}, {0x5E84, "莊"}, {0x5E86, "慶"},
    {0x5E93, "庫"}, {0x5E94, "應"}, {0x5E99, "廟"}, {0x5E9F, "廢"}, {0x5F00, "開"}, {0x5F02, "異"},
    {0x5F20, "張"}, {0x5F25, "彌"}, {0x5F2F, "彎"}, {0x5F39, "彈"}, {0x5F3A, "強"}, {0x5F52, "歸"},
    {0x5F53, "當"}, {0x5F55, "錄"}, {0x5F62, "形"}, {0x5F69, "彩"}, {0x5F71, "影"}, {0x5F7B, "徹"},
    {0x5F84, "徑"}, {0x5F8C, "後"}, {0x5F95, "徠"}, {0x5FC3, "心"}, {0x5FC6, "憶"}, {0x5FE7, "憂"},
    {0x5FEB, "快"}, {0x5FF5, "念"}, {0x6000, "懷"}, {0x6001, "態"}, {0x601C, "憐"}, {0x603B, "總"},
    {0x604B, "戀"}, {0x6052, "恆"}, {0x6073, "懇"}, {0x6076, "惡"}, {0x607C, "惱"}, {0x60A6, "悅"},
    {0x60AC, "懸"}, {0x60AF, "憫"}, {0x60CA, "驚"}, {0x60E7, "懼"}, {0x60E8, "慘"}, {0x60E9, "懲"},
    {0x60EF, "慣"}, {0x6124, "憤"}, {0x613F, "願"}, {0x6148, "慈"}, {0x6155, "慕"}, {0x6162, "慢"},
    {0x6170, "慰"}, {0x61C2, "懂"}, {0x620F, "戲"}, {0x6218, "戰"}, {0x6237, "戶"}, {0x6251, "撲"},
    {0x6267, "執"}, {0x6269, "擴"}, {0x626B, "掃"}, {0x626C, "揚"}, {0x6270, "擾"}, {0x6298, "折"},
    {0x62A4, "護"}, {0x62A5, "報"}, {0x62C5, "擔"}, {0x62DF, "擬"}, {0x62E5, "擁"}, {0x62E6, "攔"},
    {0x62E8, "撥"}, {0x62E9, "擇"}, {0x6307, "指"}, {0x6309, "按"}, {0x6311, "挑"}, {0x6325, "揮"},
    {0x635F, "損"}, {0x6362, "換"}, {0x636E, "據"}, {0x6377, "捷"}, {0x63A5, "接"}, {0x63A7, "控"},
    {0x63A8, "推"}, {0x63CF, "描"}, {0x63D0, "提"}, {0x63F4, "援"}, {0x6401, "擱"}, {0x641C, "搜"},
    {0x6444, "攝"}, {0x6446, "擺"}, {0x6447, "搖"}, {0x6458, "摘"}, {0x6469, "摩"}, {0x64AD, "播"},
    {0x64CD, "操"}, {0x64DA, "據"}, {0x64E6, "擦"}, {0x6536, "收"}, {0x6539, "改"}, {0x653B, "攻"},
    {0x653E, "放"}, {0x653F, "政"}, {0x6545, "故"}, {0x6548, "效"}, {0x654C, "敵"}, {0x6570, "數"},
    {0x6574, "整"}, {0x6587, "文"}, {0x65AD, "斷"}, {0x65B0, "新"}, {0x65B9, "方"}, {0x65E0, "無"},
    {0x65E7, "舊"}, {0x65F6, "時"}, {0x660E, "明"}, {0x661F, "星"}, {0x662F, "是"}, {0x663E, "顯"},
    {0x664B, "晉"}, {0x6653, "曉"}, {0x665A, "晚"}, {0x6682, "暫"}, {0x6697, "暗"}, {0x66A8, "暨"},
    {0x66F2, "曲"}, {0x66F4, "更"}, {0x4F1A, "會"}, {0x6708, "月"}, {0x6709, "有"}, {0x670D, "服"},
    {0x672F, "術"}, {0x673A, "機"}, {0x6740, "殺"}, {0x6742, "雜"}, {0x6743, "權"}, {0x6761, "條"},
    {0x6765, "來"}, {0x677E, "鬆"}, {0x6781, "極"}, {0x6784, "構"}, {0x679C, "果"}, {0x6807, "標"},
    {0x680B, "棟"}, {0x680F, "欄"}, {0x6811, "樹"}, {0x6837, "樣"}, {0x6838, "核"}, {0x6839, "根"},
    {0x683C, "格"}, {0x684C, "桌"}, {0x6863, "檔"}, {0x68C0, "檢"}, {0x697C, "樓"}, {0x6A21, "模"},
    {0x6A2A, "橫"}, {0x6A31, "櫻"}, {0x6B22, "歡"}, {0x6B27, "歐"}, {0x6B32, "欲"}, {0x6B3E, "款"},
    {0x6B62, "止"}, {0x6B65, "步"}, {0x6B72, "歲"}, {0x6B8B, "殘"}, {0x6BB5, "段"}, {0x6BCF, "每"},
    {0x6BD4, "比"}, {0x6C14, "氣"}, {0x6C47, "匯"}, {0x6C49, "漢"}, {0x6C64, "湯"}, {0x6C9F, "溝"},
    {0x6CA1, "沒"}, {0x6CB3, "河"}, {0x6CB9, "油"}, {0x6CBB, "治"}, {0x6CD5, "法"}, {0x6CE8, "註"},
    {0x6D3B, "活"}, {0x6D41, "流"}, {0x6D4B, "測"}, {0x6D4E, "濟"}, {0x6D53, "濃"}, {0x6D77, "海"},
    {0x6D88, "消"}, {0x6DA6, "潤"}, {0x6DB5, "涵"}, {0x6DF1, "深"}, {0x6E05, "清"}, {0x6E29, "溫"},
    {0x6E38, "遊"}, {0x6E7E, "灣"}, {0x6E90, "源"}, {0x6EE1, "滿"}, {0x6EDA, "滾"}, {0x6EF4, "滴"},
    {0x6F14, "演"}, {0x6F22, "漢"}, {0x6F5C, "潛"}, {0x6F6E, "潮"}, {0x706D, "滅"}, {0x706F, "燈"},
    {0x7075, "靈"}, {0x707E, "災"}, {0x70B9, "點"}, {0x70BC, "煉"}, {0x70C8, "烈"}, {0x70E6, "煩"},
    {0x70ED, "熱"}, {0x7136, "然"}, {0x7167, "照"}, {0x7231, "愛"}, {0x7247, "片"}, {0x7248, "版"},
    {0x7269, "物"}, {0x7279, "特"}, {0x72B6, "狀"}, {0x72EC, "獨"}, {0x72ED, "狹"}, {0x72EE, "獅"},
    {0x730E, "獵"}, {0x732B, "貓"}, {0x7387, "率"}, {0x7389, "玉"}, {0x73AF, "環"}, {0x73B0, "現"},
    {0x7406, "理"}, {0x74F6, "瓶"}, {0x7535, "電"}, {0x753B, "畫"}, {0x754C, "界"}, {0x7559, "留"},
    {0x7597, "療"}, {0x75AF, "瘋"}, {0x75DB, "痛"}, {0x767B, "登"}, {0x767D, "白"}, {0x767E, "百"},
    {0x76CA, "益"}, {0x76D1, "監"}, {0x76D8, "盤"}, {0x76EE, "目"}, {0x76F4, "直"}, {0x76F8, "相"},
    {0x770B, "看"}, {0x771F, "真"}, {0x7740, "著"}, {0x77E5, "知"}, {0x77ED, "短"}, {0x7801, "碼"},
    {0x7814, "研"}, {0x7834, "破"}, {0x786E, "確"}, {0x788E, "碎"}, {0x793A, "示"}, {0x793C, "禮"},
    {0x793E, "社"}, {0x79BB, "離"}, {0x79CD, "種"}, {0x79EF, "積"}, {0x79F0, "稱"}, {0x7A0B, "程"},
    {0x7A33, "穩"}, {0x7A7A, "空"}, {0x7A97, "窗"}, {0x7ADE, "競"}, {0x7B14, "筆"}, {0x7B49, "等"},
    {0x7B7E, "籤"}, {0x7B80, "簡"}, {0x7BA1, "管"}, {0x7C7B, "類"}, {0x7CBE, "精"}, {0x7CFB, "系"},
    {0x7EA2, "紅"}, {0x7EA7, "級"}, {0x7EAA, "紀"}, {0x7EB2, "綱"}, {0x7EB3, "納"}, {0x7EB5, "縱"},
    {0x7EB8, "紙"}, {0x7EB9, "紋"}, {0x7EBD, "紐"}, {0x7EBF, "線"}, {0x7EC3, "練"}, {0x7EC4, "組"},
    {0x7EC6, "細"}, {0x7EC7, "織"}, {0x7EC8, "終"}, {0x7ECD, "紹"}, {0x7ECF, "經"}, {0x7ED3, "結"},
    {0x7ED9, "給"}, {0x7EDC, "絡"}, {0x7EDD, "絕"}, {0x7EDF, "統"}, {0x7EE7, "繼"}, {0x7EED, "續"},
    {0x7EF4, "維"}, {0x7EF5, "綿"}, {0x7EF7, "繃"}, {0x7EFC, "綜"}, {0x7EFF, "綠"}, {0x7F16, "編"},
    {0x7F18, "緣"}, {0x7F29, "縮"}, {0x7F51, "網"}, {0x7F57, "羅"}, {0x7F5A, "罰"}, {0x7F62, "罷"},
    {0x7F8E, "美"}, {0x7FA4, "群"}, {0x7FD2, "習"}, {0x8001, "老"}, {0x8005, "者"}, {0x800C, "而"},
    {0x8054, "聯"}, {0x805A, "聚"}, {0x806A, "聰"}, {0x8083, "肅"}, {0x80A1, "股"}, {0x80B2, "育"},
    {0x80BE, "腎"}, {0x80CC, "背"}, {0x80DC, "勝"}, {0x80FD, "能"}, {0x8111, "腦"}, {0x8131, "脫"},
    {0x817E, "騰"}, {0x81EA, "自"}, {0x81F3, "至"}, {0x8206, "輿"}, {0x822C, "般"}, {0x8230, "艦"},
    {0x826F, "良"}, {0x8272, "色"}, {0x827A, "藝"}, {0x8282, "節"}, {0x82CF, "蘇"}, {0x82E5, "若"},
    {0x8303, "範"}, {0x836F, "藥"}, {0x83B7, "獲"}, {0x83DC, "菜"}, {0x8425, "營"}, {0x843D, "落"},
    {0x84DD, "藍"}, {0x85CF, "藏"}, {0x8651, "慮"}, {0x865A, "虛"}, {0x866B, "蟲"}, {0x884C, "行"},
    {0x8865, "補"}, {0x8868, "表"}, {0x888B, "袋"}, {0x88C5, "裝"}, {0x89C1, "見"}, {0x89C2, "觀"},
    {0x89C4, "規"}, {0x89C6, "視"}, {0x89C9, "覺"}, {0x89D2, "角"}, {0x89E3, "解"}, {0x8A00, "言"},
    {0x8BA1, "計"}, {0x8BA2, "訂"}, {0x8BA4, "認"}, {0x8BA8, "討"}, {0x8BA9, "讓"}, {0x8BAD, "訓"},
    {0x8BB0, "記"}, {0x8BB2, "講"}, {0x8BBE, "設"}, {0x8BBF, "訪"}, {0x8BC1, "證"}, {0x8BC4, "評"},
    {0x8BC6, "識"}, {0x8BC9, "訴"}, {0x8BCD, "詞"}, {0x8BD1, "譯"}, {0x8BD5, "試"}, {0x8BD7, "詩"},
    {0x8BDA, "誠"}, {0x8BDD, "話"}, {0x8BDE, "誕"}, {0x8BE2, "詢"}, {0x8BE5, "該"}, {0x8BE6, "詳"},
    {0x8BED, "語"}, {0x8BEF, "誤"}, {0x8BF4, "說"}, {0x8BF7, "請"}, {0x8BFB, "讀"}, {0x8BFE, "課"},
    {0x8C03, "調"}, {0x8C08, "談"}, {0x8C22, "謝"}, {0x8C31, "譜"}, {0x8D1D, "貝"}, {0x8D1F, "負"},
    {0x8D21, "貢"}, {0x8D22, "財"}, {0x8D23, "責"}, {0x8D25, "敗"}, {0x8D27, "貨"}, {0x8D28, "質"},
    {0x8D29, "販"}, {0x8D2D, "購"}, {0x8D2F, "貫"}, {0x8D34, "貼"}, {0x8D35, "貴"}, {0x8D37, "貸"},
    {0x8D39, "費"}, {0x8D44, "資"}, {0x8D4B, "賦"}, {0x8D4C, "賭"}, {0x8D5E, "讚"}, {0x8D70, "走"},
    {0x8D76, "趕"}, {0x8D77, "起"}, {0x8D85, "超"}, {0x8D8A, "越"}, {0x8DB3, "足"}, {0x8DEF, "路"},
    {0x8DF3, "跳"}, {0x8EAB, "身"}, {0x8F66, "車"}, {0x8F6C, "轉"}, {0x8F6F, "軟"}, {0x8F7B, "輕"},
    {0x8F7D, "載"}, {0x8F83, "較"}, {0x8F85, "輔"}, {0x8F86, "輛"}, {0x8F93, "輸"}, {0x8F9E, "辭"},
    {0x8FB9, "邊"}, {0x8FBE, "達"}, {0x8FC1, "遷"}, {0x8FC7, "過"}, {0x8FD0, "運"}, {0x8FD1, "近"},
    {0x8FD8, "還"}, {0x8FD9, "這"}, {0x8FDB, "進"}, {0x8FDC, "遠"}, {0x8FDE, "連"}, {0x8FDF, "遲"},
    {0x8FF0, "述"}, {0x8FF7, "迷"}, {0x9000, "退"}, {0x9001, "送"}, {0x9002, "適"}, {0x9009, "選"},
    {0x901A, "通"}, {0x901F, "速"}, {0x9020, "造"}, {0x903B, "邏"}, {0x9053, "道"}, {0x9065, "遙"},
    {0x90AE, "郵"}, {0x90BB, "鄰"}, {0x90E8, "部"}, {0x90FD, "都"}, {0x914D, "配"}, {0x91C7, "採"},
    {0x91CC, "裡"}, {0x91CD, "重"}, {0x91D1, "金"}, {0x9274, "鑑"}, {0x94A2, "鋼"}, {0x94B1, "錢"},
    {0x94C1, "鐵"}, {0x94F6, "銀"}, {0x94FE, "鏈"}, {0x9501, "鎖"}, {0x9519, "錯"}, {0x952E, "鍵"},
    {0x955C, "鏡"}, {0x957F, "長"}, {0x95E8, "門"}, {0x95EA, "閃"}, {0x95ED, "閉"}, {0x95EE, "問"},
    {0x95F2, "閒"}, {0x95F4, "間"}, {0x95FB, "聞"}, {0x95FD, "閩"}, {0x961F, "隊"}, {0x9633, "陽"},
    {0x9634, "陰"}, {0x9636, "階"}, {0x9645, "際"}, {0x9646, "陸"}, {0x9648, "陳"}, {0x9650, "限"},
    {0x9669, "險"}, {0x968F, "隨"}, {0x9690, "隱"}, {0x96BE, "難"}, {0x96C6, "集"}, {0x96EA, "雪"},
    {0x96F6, "零"}, {0x96FE, "霧"}, {0x9700, "需"}, {0x9752, "青"}, {0x9759, "靜"}, {0x9762, "面"},
    {0x97E6, "韋"}, {0x9875, "頁"}, {0x9876, "頂"}, {0x9879, "項"}, {0x987A, "順"}, {0x987B, "須"},
    {0x987E, "顧"}, {0x9884, "預"}, {0x9886, "領"}, {0x9891, "頻"}, {0x9898, "題"}, {0x989C, "顏"},
    {0x98CE, "風"}, {0x98DE, "飛"}, {0x98DF, "食"}, {0x996E, "飲"}, {0x9970, "飾"}, {0x9971, "飽"},
    {0x9972, "飼"}, {0x9986, "館"}, {0x9996, "首"}, {0x9999, "香"}, {0x9A6C, "馬"}, {0x9A71, "驅"},
    {0x9A8C, "驗"}, {0x9AD8, "高"}, {0x9C7C, "魚"}, {0x9E1F, "鳥"}, {0x9E21, "雞"}, {0x9E23, "鳴"},
    {0x9EC4, "黃"}, {0x9ED1, "黑"}, {0x9F50, "齊"}, {0x9F7F, "齒"}, {0x9F99, "龍"}, {0x9F9F, "龜"},
};

const CharMapping* findCharMapping(uint32_t cp) {
  for (const auto& mapping : kCharMappings) {
    if (mapping.simplified == cp) {
      return &mapping;
    }
  }
  return nullptr;
}

const PhraseMapping* findPhraseMapping(const char* cursor, const char* end) {
  for (const auto& mapping : kPhraseMappings) {
    const size_t len = strlen(mapping.simplified);
    if (cursor + len <= end && strncmp(cursor, mapping.simplified, len) == 0) {
      return &mapping;
    }
  }
  return nullptr;
}
}  // namespace

namespace EpubTextTransform {

std::string simplifiedToTraditional(const char* text, const int len) {
  if (!text || len <= 0) {
    return "";
  }

  std::string converted;
  converted.reserve(static_cast<size_t>(len) + 8);
  const auto* cursor = reinterpret_cast<const unsigned char*>(text);
  const auto* end = reinterpret_cast<const unsigned char*>(text + len);

  while (cursor < end && *cursor != 0) {
    if (const auto* phrase = findPhraseMapping(reinterpret_cast<const char*>(cursor), reinterpret_cast<const char*>(end))) {
      converted += phrase->traditional;
      cursor += strlen(phrase->simplified);
      continue;
    }

    const auto* before = cursor;
    const uint32_t cp = utf8NextCodepoint(&cursor);
    if (cursor > end) {
      converted.append(reinterpret_cast<const char*>(before), static_cast<size_t>(end - before));
      break;
    }
    if (const auto* mapping = findCharMapping(cp)) {
      converted += mapping->traditional;
    } else {
      converted.append(reinterpret_cast<const char*>(before), static_cast<size_t>(cursor - before));
    }
  }
  return converted;
}

std::string simplifiedToTraditional(const std::string& text) {
  return simplifiedToTraditional(text.c_str(), static_cast<int>(text.size()));
}

}  // namespace EpubTextTransform
